## firmware/components/bench/Kconfig
```kconfig
menu "PRISM Decode Bench"

config PRISM_BENCH_AUTORUN
    bool "Auto-run decode bench at boot"
    default n
    help
        If enabled, the decode benchmark harness starts automatically at boot
        and runs for the configured number of frames.

config PRISM_BENCH_FRAMES
    int "Number of frames to run"
    range 1 8192
    default 480
    help
        Total frames to benchmark before printing summary JSON.

config PRISM_BENCH_LED_COUNT
    int "LED count per channel"
    range 1 1024
    default 160
    help
        Number of LEDs processed per frame (affects workload size).

config PRISM_BENCH_PERIOD_US
    int "Target frame period (microseconds)"
    range 1000 50000
    default 8333
    help
        Frame cadence period in microseconds. 8333 ~= 120 FPS.

config PRISM_BENCH_ENABLE_FILE
    bool "Write JSON summary to file"
    default n
    help
        If enabled, the harness attempts to write a JSON summary to the
        configured file path after completion.

config PRISM_BENCH_FILE_PATH
    string "Metrics file path"
    depends on PRISM_BENCH_ENABLE_FILE
    default "/spiffs/bench_decode.jsonl"
    help
        File path for JSON summary output. Ensure filesystem is mounted.

config PRISM_BENCH_REGISTER_CLI
    bool "Register console command"
    default y
    help
        Registers a console command `bench_decode` to run the benchmark at
        runtime with optional overrides for pattern, frames, LED count, and
        frame period.

choice PRISM_BENCH_PATTERN
    prompt "Decode workload pattern"
    default PRISM_BENCH_PATTERN_PALETTE

config PRISM_BENCH_PATTERN_PALETTE
    bool "Palette + indices"

config PRISM_BENCH_PATTERN_XOR_DELTA
    bool "XOR delta stream"

config PRISM_BENCH_PATTERN_RLE
    bool "RLE bursts"

endchoice

endmenu
```

## firmware/components/network/Kconfig
```kconfig
menu "PRISM Network/Test"

config PRISM_UART_TEST
    bool "Enable UART test mode"
    default y
    help
      Enables a simple UART0 line-based command interface for BEGIN/DATA/END
      and CONTROL commands to drive uploads without Wi‑Fi.

endmenu
```

## firmware/components/playback/Kconfig
```kconfig
menu "PRISM Playback Configuration"

config PRISM_PROFILE_TEMPORAL
    bool "Enable temporal profiling"
    default n
    help
        Enable cycle-accurate profiling of temporal calculations.
        Adds small code size overhead. Disable in production.

config PRISM_PROFILE_COUNT_DCACHE
    bool "Profile DCache hit/miss rates"
    depends on PRISM_PROFILE_TEMPORAL
    default y
    help
        Collect data cache hit/miss counters using PMU (D_ACCESS_U1).
        Adds two performance counters when enabled.

config PRISM_PROFILE_COUNT_ICACHE
    bool "Profile ICache hit/miss rates"
    depends on PRISM_PROFILE_TEMPORAL
    default y
    help
        Collect instruction cache hit/miss counters using PMU (I_MEM).
        Adds two performance counters when enabled.

config PRISM_PROFILE_COUNT_INSN
    bool "Profile instruction count (INSN)"
    depends on PRISM_PROFILE_TEMPORAL
    default n
    help
        Collect successfully retired instruction count. May be skipped at
        runtime if all PMU counters are used by cache profiling.

endmenu

menu "PRISM Metrics Exposure"

config PRISM_METRICS_HTTP
    bool "Expose profiling metrics via HTTP endpoint"
    default y
    help
        Adds a JSON endpoint /metrics/wave to the captive portal HTTP server
        that returns the current WAVE profiling statistics.

config PRISM_METRICS_CLI
    bool "Expose profiling metrics via CLI command"
    default y
    help
        Registers a console command `prism_metrics` to print current metrics.

config PRISM_METRICS_PROMETHEUS
    bool "Expose Prometheus text endpoint (/metrics)"
    depends on PRISM_METRICS_HTTP
    default y
    help
        Adds a text/plain Prometheus exposition endpoint at /metrics.

config PRISM_METRICS_CSV
    bool "Expose CSV endpoint (/metrics.csv)"
    depends on PRISM_METRICS_HTTP
    default n
    help
        Adds a CSV snapshot endpoint for simple scripting.

config PRISM_METRICS_PUSH
    bool "Periodically push metrics to HTTP endpoint"
    default n
    help
        When enabled, a background task will POST JSON metrics to the URL
        configured below at the specified interval.

config PRISM_METRICS_PUSH_URL
    string "Metrics push URL (e.g., http://host:port/api/metrics)"
    depends on PRISM_METRICS_PUSH
    default ""

config PRISM_METRICS_PUSH_INTERVAL_SEC
    int "Metrics push interval (seconds)"
    depends on PRISM_METRICS_PUSH
    range 1 3600
    default 10

endmenu
```

## firmware/sdkconfig.defaults
```kconfig
# PRISM K1 Firmware Default Configuration
# ESP32-S3 optimized settings

# Target Configuration
CONFIG_IDF_TARGET="esp32s3"
CONFIG_IDF_TARGET_ESP32S3=y

# FreeRTOS Configuration
CONFIG_FREERTOS_HZ=1000
CONFIG_FREERTOS_UNICORE=n
CONFIG_ESP_MAIN_TASK_STACK_SIZE=8192
CONFIG_FREERTOS_TIMER_TASK_STACK_DEPTH=4096
CONFIG_FREERTOS_USE_TRACE_FACILITY=y
CONFIG_FREERTOS_GENERATE_RUN_TIME_STATS=n

# WiFi Configuration
CONFIG_ESP32_WIFI_STATIC_RX_BUFFER_NUM=16
CONFIG_ESP32_WIFI_DYNAMIC_RX_BUFFER_NUM=32
CONFIG_ESP32_WIFI_TX_BUFFER_TYPE=1
CONFIG_ESP32_WIFI_DYNAMIC_TX_BUFFER_NUM=32
CONFIG_ESP32_WIFI_AMPDU_TX_ENABLED=y
CONFIG_ESP32_WIFI_AMPDU_RX_ENABLED=y
CONFIG_ESP_WIFI_AP_SSID="PRISM-SETUP"
CONFIG_ESP_WIFI_AP_PASSWORD=""

# HTTP Server Configuration
CONFIG_HTTPD_MAX_REQ_HDR_LEN=1024
CONFIG_HTTPD_MAX_URI_LEN=256
CONFIG_HTTPD_WS_SUPPORT=y

# WebSocket Configuration
CONFIG_WS_TRANSPORT=y
CONFIG_WS_BUFFER_SIZE=4096

# Partition Table
CONFIG_PARTITION_TABLE_CUSTOM=y
CONFIG_PARTITION_TABLE_CUSTOM_FILENAME="partitions.csv"
CONFIG_PARTITION_TABLE_FILENAME="partitions.csv"

# Flash Configuration
CONFIG_ESPTOOLPY_FLASHMODE_QIO=y
CONFIG_ESPTOOLPY_FLASHFREQ_80M=y
CONFIG_ESPTOOLPY_FLASHSIZE_8MB=y

# Optimization
CONFIG_COMPILER_OPTIMIZATION_SIZE=y
CONFIG_COMPILER_OPTIMIZATION_ASSERTIONS_ENABLE=y

# Heap Configuration
CONFIG_HEAP_POISONING_LIGHT=y
CONFIG_HEAP_TRACING_OFF=y

# Log Configuration
CONFIG_LOG_DEFAULT_LEVEL_INFO=y
CONFIG_LOG_COLORS=y
CONFIG_LOG_TIMESTAMP_SOURCE_RTOS=y

# mDNS Configuration
CONFIG_MDNS_MAX_SERVICES=5
CONFIG_MDNS_TASK_STACK_SIZE=4096

# LED Strip (RMT) Configuration
CONFIG_WS2812_LED_RMT_CHANNEL=0
CONFIG_WS2812_LED_RMT_INTERRUPT_NUM=19

# LittleFS Configuration
CONFIG_LITTLEFS_MAX_PARTITIONS=1
CONFIG_LITTLEFS_PAGE_SIZE=256
CONFIG_LITTLEFS_OBJ_NAME_LEN=32
CONFIG_LITTLEFS_READ_SIZE=128
CONFIG_LITTLEFS_WRITE_SIZE=128
CONFIG_LITTLEFS_LOOKAHEAD_SIZE=128
CONFIG_LITTLEFS_CACHE_SIZE=512
CONFIG_LITTLEFS_BLOCK_CYCLES=512

# Power Management
CONFIG_PM_ENABLE=n

# Watchdog Configuration
CONFIG_ESP_TASK_WDT=y
CONFIG_ESP_TASK_WDT_TIMEOUT_S=10
CONFIG_ESP_TASK_WDT_PANIC=y
```
